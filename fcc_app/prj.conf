## CMakeLists.txt
```
# SPDX-License-Identifier: Apache-2.0
cmake_minimum_required(VERSION 3.20.0)
find_package(Zephyr REQUIRED HINTS $ENV{ZEPHYR_BASE})
project(fcc_app)

target_sources(app PRIVATE
    src/main.c
    src/transport/uart_rx.c
    src/protocol/frame_parser.c
    src/common/ring_buffer.c
    src/application/frame_handler.c
    src/application/radar_processor.c
    src/application/report_sender.c
    src/protocol/measurement_message.c
    src/tracking/gating.c
    src/tracking/angle_utils.c
    src/tracking/track.c
    src/transport/rx_frame_processor.c
    src/transport/uart_tx.c
    src/protocol/protocol_frame.c
    src/common/crc16.c
    src/protocol/status_message.c
    src/protocol/track_message.c
)

include(cmake/estimator.cmake)
if(CONFIG_RADAR_ESTIMATOR_EKF_CT)
    radar_target_estimator(app EKF_CT)
elseif(CONFIG_RADAR_ESTIMATOR_EKF_CV)
    radar_target_estimator(app EKF_CV)
else()
    radar_target_estimator(app KF_CV)
endif()

# Resolve module-qualified includes from the application source root.
target_include_directories(app PRIVATE ${CMAKE_CURRENT_SOURCE_DIR}/src)

# Optional bench diagnostics; no collector or reporter is linked into normal firmware.
target_sources_ifdef(CONFIG_RADAR_PERF_MONITOR app PRIVATE
    src/diagnostics/perf_monitor.c
    src/diagnostics/perf_rx_capture.c
    src/diagnostics/perf_reporter.c
)

if(CONFIG_RADAR_PERF_MONITOR AND CONFIG_SCHED_THREAD_USAGE_ALL)
    target_sources(app PRIVATE src/diagnostics/perf_resources.c)
endif()

# Bench-only producer; excluded from normal and ordinary debug firmware.
target_sources_ifdef(CONFIG_RADAR_LOG_STRESS_TEST app PRIVATE tests/log_stress/log_stress.c)

target_sources_ifdef(CONFIG_RADAR_TRANSPORT_STRESS_TEST app PRIVATE tests/transport_stress/transport_stress.c)
```

## Kconfig
```
mainmenu "Radar tracking firmware"

# Zephyr platform, board, driver, and kernel configuration definitions.
# The build command selects the board; its defconfig supplies board defaults.
source "Kconfig.zephyr"

# Application tuning options; select values in prj.conf.
menu "Radar application settings"

choice RADAR_ESTIMATOR
    prompt "Tracking estimator"
    default RADAR_ESTIMATOR_KF_CV

config RADAR_ESTIMATOR_KF_CV
    bool "KF: independent range/azimuth CV (default)"
    help
        Preserve the existing independent polar constant-velocity filters.

config RADAR_ESTIMATOR_EKF_CV
    bool "EKF: Cartesian CV with polar measurements"
    help
        Track x, y, vx, vy with a Cartesian constant-velocity model.
        Correct using radar range and azimuth with a Joseph covariance update.
        Uses the same measurement R settings, gates and track lifecycle.
        Initial velocity is zero; P and Q are initial tuning values.

config RADAR_ESTIMATOR_EKF_CT
    bool "EKF: Cartesian coordinated turn with polar measurements"
    help
        Estimate x, y, vx, vy and clockwise turn rate in rad/s.
        Use exact constant-turn motion and a Joseph measurement update.
        Velocity and turn rate initialize at zero with positive uncertainty.
        Retain the shared measurement R, gates and lifecycle; tune separately.

endchoice

config RADAR_CT_ACCELERATION_VARIANCE_M_SQUARED_PER_S_FOURTH
    int "CT Cartesian acceleration variance (m^2/s^4)"
    depends on RADAR_ESTIMATOR_EKF_CT
    range 0 2147483647
    default 100
    help
        Independent per-step x/y acceleration disturbances, variance not sigma.
        Add q times dt^4/4, dt^3/2 and dt^2 to each position/velocity block.
        Does not modify KF/CV Q, measurement R, initial P or gates.

config RADAR_CT_ANGULAR_ACCELERATION_VARIANCE_RAD_SQUARED_PER_S_FOURTH_SCALED_1E9
    int "CT angular acceleration variance (1e-9 rad^2/s^4)"
    depends on RADAR_ESTIMATOR_EKF_CT
    range 0 2147483647
    default 100000
    help
        Divide this integer by 1e9 to obtain angular acceleration variance.
        The default is 0.0001 rad^2/s^4, sigma 0.01 rad/s^2.
        Add q_alpha times dt^2 to next-step turn-rate variance. This additive
        model does not integrate angular acceleration inside the predicted arc.

config RADAR_CT_INITIAL_TURN_RATE_VARIANCE_RAD_SQUARED_PER_S_SQUARED_SCALED_1E9
    int "CT initial turn-rate variance (1e-9 rad^2/s^2)"
    depends on RADAR_ESTIMATOR_EKF_CT
    range 1 2147483647
    default 10000000
    help
        Initial turn rate is zero. Divide this positive integer by 1e9 for
        its variance: default 0.01 rad^2/s^2, sigma 0.1 rad/s.
        Other initial position/velocity uncertainties match the CV adapter.

# Cartesian CV process noise; the core applies the interval-dependent Q terms.
config RADAR_EKF_ACCELERATION_VARIANCE_M_SQUARED_PER_S_FOURTH
    int "EKF acceleration variance (m^2/s^4)"
    depends on RADAR_ESTIMATOR_EKF_CV
    range 0 2147483647
    default 100
    help
        Independent acceleration variance shared by the x and y axes.
        This is variance, not standard deviation: sigma 10 m/s^2 means 100.
        The CV filter multiplies it by dt^4/4, dt^3/2 and dt^2 to form Q.
        Zero disables process noise; it does not reset the covariance.
        Does not change the polar KF, initial P, measurement R, or gates.

# RX buffer recovery policy.
choice RADAR_RX_OVERFLOW_POLICY
    prompt "RX overflow recovery policy"
    default RADAR_RX_OVERFLOW_DRAIN

config RADAR_RX_OVERFLOW_DRAIN
    bool "Drain buffered frames"
    help
        Process frames that can be completed from buffered bytes,
        then discard any remaining partial frame.

config RADAR_RX_OVERFLOW_DISCARD
    bool "Discard all buffered data"
    help
        Discard all buffered bytes and reset partial frame assembly.

endchoice

# Independent timeout limits, expressed in milliseconds.
config RADAR_FRAME_RX_TIMEOUT_MS
    int "Partial frame timeout (ms)"
    range 1 60000
    default 1000
    help
        Reset an incomplete frame when no further byte is processed
        within this interval. Idle parsers are not monitored.

config RADAR_MEASUREMENT_TIMEOUT_MS
    int "Radar measurement timeout (ms)"
    range 1 60000
    default 1000
    help
        Clear the track when no decoded and validated measurement
        is received within this interval. Monitoring starts only
        after the first valid measurement.

# Rectangular measurement gates: maximum absolute errors, not full window widths.
config RADAR_RANGE_GATE_M
    int "Range gate half-width (m)"
    range 1 65535
    default 100
    help
        Accept a measurement only when its absolute range error is at most
        this value in meters. The angular gate must also pass.
        This is a fixed threshold, not a covariance-based gate.

config RADAR_AZIMUTH_GATE_DEG
    int "Azimuth gate half-width (degrees)"
    range 1 180
    default 10
    help
        Maximum absolute wrapped angular error, including the boundary.
        Configuration uses whole degrees; calculations use radians.
        At 180 degrees every finite normalized angular error passes,
        but the range gate still applies.

# Measurement variances R; independent of initial P, process Q, and gates.
config RADAR_RANGE_MEASUREMENT_VARIANCE_M_SQUARED
    int "Range measurement variance R (m^2)"
    range 1 2147483647
    default 25
    help
        Measurement variance, not standard deviation: sigma 30 m means 900.
        Does not change initial covariance, process noise, or gate thresholds.

config RADAR_AZIMUTH_MEASUREMENT_VARIANCE_RAD_SQUARED_SCALED_1E9
    int "Azimuth measurement variance R (1e-9 rad^2)"
    range 1 2147483647
    default 1218470
    help
        Divide this integer by 1,000,000,000 to obtain variance in rad^2.
        This unit is 1e-9 rad^2, NOT squared nanoradians.
        For sigma 0.03 rad use 900000 (R = 0.0009 rad^2).
        The default preserves the previous R = 0.00121847 rad^2.
        Does not change initial covariance, process noise, or gate thresholds.

# Generate per-module log levels and their OFF/ERR/WRN/INF/DBG choices.
# Select a choice in prj.conf or debug.conf; do not assign the derived integer.
# The template depends on LOG and uses LOG_DEFAULT_LEVEL for its Default choice.
menu "Application logging"
module = RADAR_MAIN
module-str = Radar startup
source "subsys/logging/Kconfig.template.log_config"

module = RADAR_UART_RX
module-str = Radar UART RX
source "subsys/logging/Kconfig.template.log_config"

module = RADAR_RX_PROCESSOR
module-str = Radar RX frame processor
source "subsys/logging/Kconfig.template.log_config"

module = RADAR_UART_TX
module-str = Radar UART TX
source "subsys/logging/Kconfig.template.log_config"

module = RADAR_HANDLER
module-str = Radar frame handler
source "subsys/logging/Kconfig.template.log_config"
endmenu

config RADAR_PERF_MONITOR
    bool "Enable application performance measurements"
    depends on LOG
    select INIT_STACKS
    select THREAD_STACK_INFO
    select TIMING_FUNCTIONS
    default n
    help
        Collect RX byte residence, ISR/parser execution, measurement
        processing, TX queue/polling and parsed-RX-to-polling timing.
        Main prints cumulative summaries and sampled stack headroom every
        five seconds. perf.conf also enables scheduler runtime accounting.
        Enable with perf.conf in a separate build. Instrumentation and
        logging add overhead; this does not prove physical transmission
        completion, peer receipt, or worst-case execution time.

config RADAR_LOG_STRESS_TEST
    bool "Run a bounded log saturation test after boot"
    depends on LOG_MODE_DEFERRED && LOG_PROCESS_THREAD && ASSERT
    default n
    help
        Bench testing only. Generate numbered log bursts once after boot
        to exercise log-buffer exhaustion while UART traffic continues.
        Do not enable in normal firmware. See tests/log_stress/README.md.

config RADAR_TRANSPORT_STRESS_TEST
    bool "Run bounded UART consumer suspension for bench testing"
    depends on LOG_MODE_DEFERRED && LOG_PROCESS_THREAD
    default n
    help
        Bench only: suspend RX, handler, and TX consumers in turn while
        interrupts remain enabled. See tests/transport_stress/README.md.

endmenu
```

## prj.conf
```kconfig
# Normal firmware configuration; debug.conf adds assertions and debug logging.

# Platform drivers and console support.
CONFIG_SERIAL=y
CONFIG_CONSOLE=y
CONFIG_UART_CONSOLE=y
CONFIG_PRINTK=y
CONFIG_UART_INTERRUPT_DRIVEN=y
CONFIG_CBPRINTF_FP_SUPPORT=y

# Application recovery policy and timeout values (milliseconds).
CONFIG_RADAR_RX_OVERFLOW_DRAIN=y
CONFIG_RADAR_FRAME_RX_TIMEOUT_MS=1000
CONFIG_RADAR_MEASUREMENT_TIMEOUT_MS=1000

# Inclusive gate half-widths: +/- meters and +/- whole degrees around prediction.
CONFIG_RADAR_RANGE_GATE_M=100
CONFIG_RADAR_AZIMUTH_GATE_DEG=10

# Measurement variances R (not standard deviations); P and Q remain independent.
# Estimator defaults to CONFIG_RADAR_ESTIMATOR_KF_CV; ekf.conf selects Cartesian EKF.
CONFIG_RADAR_RANGE_MEASUREMENT_VARIANCE_M_SQUARED=25
# Integer units of 1e-9 rad^2: 1218470 -> 0.00121847 rad^2.
CONFIG_RADAR_AZIMUTH_MEASUREMENT_VARIANCE_RAD_SQUARED_SCALED_1E9=1218470

# Enable Zephyr logging. Deferred mode buffers messages before formatting/output.
CONFIG_LOG=y
CONFIG_LOG_MODE_DEFERRED=y
# Let Zephyr create the worker that processes buffered log messages.
CONFIG_LOG_PROCESS_THREAD=y
# Use the console UART (ST-Link), not the USART6 protocol data link.
CONFIG_LOG_BACKEND_UART=y
# Redirect remaining printk calls through logging. They are not module-filtered.
CONFIG_LOG_PRINTK=y

# Compile application error, warning, and info logs; omit debug logs.
CONFIG_RADAR_MAIN_LOG_LEVEL_INF=y
CONFIG_RADAR_UART_RX_LOG_LEVEL_INF=y
CONFIG_RADAR_RX_PROCESSOR_LOG_LEVEL_INF=y
CONFIG_RADAR_HANDLER_LOG_LEVEL_INF=y
CONFIG_RADAR_UART_TX_LOG_LEVEL_INF=y

# Allocate 4096 bytes for log messages, separate from RX/TX queues and stacks.
# This is a starting size, not a guarantee against log loss under load.
CONFIG_LOG_BUFFER_SIZE=4096

# Do not wait for free log-buffer space in application threads.
CONFIG_LOG_BLOCK_IN_THREAD=n
# On allocation failure, drop the new log instead of evicting older logs.
# This policy affects diagnostic logs, not the UART RX overflow policy.
CONFIG_LOG_MODE_OVERFLOW=n
```

## ekf.conf
```kconfig
# Build with -DEXTRA_CONF_FILE=ekf.conf in a separate build directory.
CONFIG_RADAR_ESTIMATOR_EKF_CV=y
```

## ekf_ct.conf
```kconfig
CONFIG_RADAR_ESTIMATOR_EKF_CT=y
```

## perf.conf
```kconfig
# Performance measurement overlay: merge with prj.conf, without debug.conf.
# Build separately with -DEXTRA_CONF_FILE=perf.conf (for example, build_perf).
# Keep normal INFO logging; per-measurement DEBUG output changes the workload.

# Collect boot-lifetime diagnostics and log a summary every five seconds.
CONFIG_RADAR_PERF_MONITOR=y

# Measure estimator predict/correct calls and report cumulative execution costs.
CONFIG_TIMING_FUNCTIONS=y

# Fill stacks at initialization and retain their bounds for stack-space queries.
# The performance monitor selects these too; keep their measurement cost explicit.
CONFIG_INIT_STACKS=y
CONFIG_THREAD_STACK_INFO=y

# Account non-idle/idle scheduled time; this is not isolated ISR CPU utilization.
CONFIG_THREAD_RUNTIME_STATS=y
CONFIG_SCHED_THREAD_USAGE_ALL=y

# Measure normal execution without synthetic log bursts or consumer suspension.
CONFIG_RADAR_LOG_STRESS_TEST=n
CONFIG_RADAR_TRANSPORT_STRESS_TEST=n
```

## src/main.c
```c
#include <zephyr/kernel.h>
#include <zephyr/logging/log.h>
#if defined(CONFIG_TIMING_FUNCTIONS)
#include <zephyr/timing/timing.h>
#endif

#if defined(CONFIG_RADAR_PERF_MONITOR)
#include "diagnostics/perf_reporter.h"
#endif
#include "transport/uart_rx.h"
#include "transport/uart_tx.h"

LOG_MODULE_REGISTER(radar_main, CONFIG_RADAR_MAIN_LOG_LEVEL);

int main(void)
{
    // Console diagnostics are separate from USART6 protocol frames.
    LOG_INF("FCC boot: status=starting");

#if defined(CONFIG_TIMING_FUNCTIONS)
    // Initialize once before enabling UART interrupts or releasing queued work.
    timing_init();
    timing_start();
#endif

    // Prepare the transmit path before enabling reception.
    // These init APIs return 0 on success and a negative errno on failure.
    int ret = uart_tx_init();
    if (ret != 0) {
        return ret;
    }

    ret = uart_rx_init();
    if (ret != 0) {
        return ret;
    }

    LOG_INF("FCC ready: uart=USART6 rx=ready tx=ready");

    // Reuse main for low-rate diagnostics; normal builds keep the idle loop.
    while (1) {
#if defined(CONFIG_RADAR_PERF_MONITOR)
        k_sleep(K_SECONDS(5));
        perf_reporter_log_summary();
#else
        k_sleep(K_SECONDS(1));
#endif
    }

    return 0;
}
```
